/* SPDX-License-Identifier: GPL-2.0+ */
/* SPDX-FileCopyrightText: Alexander Shiyan <shc_work@mail.ru> */

/dts-v1/;
/plugin/;

&i2c_mux {
	status = "okay";
};

&vcc_cam0 {
	vin-supply = <&vcc3v3_sys>;
};

&vcc_cam1 {
	vin-supply = <&vcc3v3_sys>;
};
